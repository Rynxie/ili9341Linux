/dts-v1/;
/plugin/;
/ {

    compatible = "bcrm,bcm2835";
    fragment@0 {
        target-path = "/";
        __overlay__{
            ili9341 {
                compatible = "tufan,ili9341";
                noSignalText = "No Signal";
                backlight-gpio = <&gpio 22 0>;
                dc-gpio = <&gpio 27 0>;
                reset-gpio = <&gpio 17 0>;
                userLed-gpio = <&gpio 23 1>;
            };
        };
    
    };
};
